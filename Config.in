## package/trellis_radio/Config.in
```kconfig
config BR2_PACKAGE_TRELLIS_RADIO
	bool "trellis_radio"
	depends on BR2_LINUX_KERNEL
	help
	  ESP32C6 SDIO WiFi host driver (trellis_radio) for the Trellis Pi
	  board.

	  https://github.com/gworkman/trellis_radio

comment "trellis_radio needs a Linux kernel to be built"
	depends on !BR2_LINUX_KERNEL
```
